## Documentation/devicetree/bindings/pci/kalray,kvx-pcimsi.txt
```
Kalray MSI/MSI-X controller DT description



Required properties :
- compatible: Should contain "kalray,kvx-pcimsi"
- reg : an array containing the MSI/MSI-X controller registers location.
        (up to 8 controller are supported)
- composite-parent : array of pointers to itgen responsible for interrupt generation
		towards the core. The number of elements shall be the same as the
		number of reg entries.
- msi-controller : indicate that the device is a msi controller.



Example :

itgen_pcie0: itgen_pcie@0x1128310000 {
	...
};

itgen_pcie1: itgen_pcie@0x1128310000 {
	...
};

itgen_pcie2: itgen_pcie@0x1128310000 {
	...
};

itgen_pcie3: itgen_pcie@0x1128310000 {
	...
};

itgen_pcie4: itgen_pcie@0x1128310000 {
	...
};

itgen_pcie5: itgen_pcie@0x1128310000 {
	...
};

itgen_pcie6: itgen_pcie@0x1128310000 {
	...
};

itgen_pcie7: itgen_pcie@0x1128310000 {
	...
};

pcimsi_ctrl: pcimsi@0 {
	compatible = "kalray,kvx-pcimsi";
	reg = <0x51 0x28312000 0x0 0x1000>,
		  <0x51 0x28316000 0x0 0x1000>,
		  <0x51 0x2831A000 0x0 0x1000>,
		  <0x51 0x2831E000 0x0 0x1000>,
		  <0x51 0x28322000 0x0 0x1000>,
		  <0x51 0x28326000 0x0 0x1000>,
		  <0x51 0x2832A000 0x0 0x1000>,
		  <0x51 0x2832E000 0x0 0x1000>;
	composite-parents =
		<&itgen_pcie0>,
		<&itgen_pcie1>,
		<&itgen_pcie2>,
		<&itgen_pcie3>,
		<&itgen_pcie4>,
		<&itgen_pcie5>,
		<&itgen_pcie6>,
		<&itgen_pcie7>;
	msi-controller;
};
```

## Documentation/devicetree/bindings/pci/kalray,subsys-pcie.txt
```
* Kalray initialization of PCIe subsystem settings

The presence of this node in the device tree is mandatory for PCIe-rc to work.
This module allow to enable or disable the Data Asynchronous Memory Error
(DAME). When disabled a failed non posted PCIe transaction will not generate a
DAME and thus will prevent the kernel to crash.
When DAME is disable, it is strongly recommended to activate AER, as then in
case of failed transaction a recovery procedure is started.

Required properties:
- compatible: Should contain "kalray,subsys-pcie"
- reg = contains "pcie subsystem" and "bar decoder" address and length
- reg-names = must include "pcie_subsys"
- #address-cells: Address representation, must be set to <2>
- #size-cells: Size representation, must be set to <2>
- kalray,ftu-dev : must contain a reference to syscon ftu device
- kalray,kalray,phycore-dev : must contain a reference to syscon phycore device

Optional properties:
- kalray,disable-dame
	- if not present use default (at reset) settings
	- = <0> : DAME generation is enabled
	- = <1> : DAME generation is disabled
- kalray,force-phy-rst : If absent the value 0 is assumed.
	When 1, all PCIe PHY will be reseted, this might have an impact on already
	configured enpoints by the FSBL, this should only be used for test purpose.
- kalray,ovrd-nfurc : if absent 0 is assumed, otherwize change the n-furcation
  settings.

Example 1 :
+++++++++++
This is a minimal example which keep all default settings

pcie_subsys: pcie_subsys@5128350000 {
	compatible = "kalray,subsys-pcie";
	reg = <0x51 0x28350000 0x0 0x1000>; /* pcie subsystem */
	reg-names = "pcie_subsys", "bar_decoder";
	kalray,ftu-dev = <&ftu>;
	kalray,phycore-dev = <&pcie_rc_phycore>;
	#address-cells = <2>;
	#size-cells = <2>;
	ranges;
};

Example 2 :
+++++++++++
This is an advanced settings which overide default settings.

pcie_subsys: pcie_subsys@5128350000 {
			compatible = "kalray,subsys-pcie";
			reg = <0x51 0x28350000 0x0 0x1000>; /* pcie subsystem */
			reg-names = "pcie_subsys", "bar_decoder";
			kalray,ftu-dev = <&ftu>;
			kalray,phycore-dev = <&pcie_rc_phycore>;
			kalray,force-phy-rst = <1>; /* if 1 force reset of all PCIe PHYs */
			kalray,ovrd-nfurc = <1>; /* if present define n-furcation mode --> 2X8 */
			kalray,disable-dame = <0>; /* if 1 do not generate DAME when read access fail */
			#address-cells = <2>;
			#size-cells = <2>;
			ranges;
}
```

## Documentation/devicetree/bindings/perf/kalray-pm.txt
```
* Kalray kvx Performance Monitors

KVX core has several Performance Monitors for counting cpu and cache events.
The KVX PM representation in the device tree should be done as under:

Required properties:

- compatible :
	"kalray,kvx-core-pm"

- interrupts : The interrupt number for kvx PM is 3.
- interrupt-parent : The kvx core interrupt controller.
- kalray,pm-num : Number of Performance Monitors the kvx core has.

Example:
core_pm {
	compatible = "kalray,kvx-core-pm";
	interrupts = <3>;
	interrupt-parent = <&core_intc>;
	kalray,pm-num = <4>;
}
```

## Documentation/devicetree/bindings/pinctrl/snps-dwapb-gpio.txt
```
* Synopsys DesignWare APB GPIO & pinmux controller

Required properties:
- compatible : Should contain "snps,dw-apb-gpio"
- reg : Address and length of the register set for the device.
- #address-cells : should be 1 (for addressing port subnodes).
- #size-cells : should be 0 (port subnodes).

The GPIO controller has a configurable number of ports, each of which are
represented as child nodes with the following properties:

Required properties:
- compatible : "snps,dw-apb-gpio-port"
- gpio-controller : Marks the device node as a gpio controller.
- #gpio-cells : Should be two.  The first cell is the pin number and
  the second cell is used to specify the gpio polarity:
      0 = active high
      1 = active low
- reg : The integer port index of the port, a single cell.

Optional properties:
- interrupt-controller : The first port may be configured to be an interrupt
controller.
- #interrupt-cells : Specifies the number of cells needed to encode an
  interrupt.  Shall be set to 2.  The first cell defines the interrupt number,
  the second encodes the triger flags encoded as described in
  Documentation/devicetree/bindings/interrupt-controller/interrupts.txt
- interrupts : The interrupts to the parent controller raised when GPIOs
  generate the interrupts. If the controller provides one combined interrupt
  for all GPIOs, specify a single interrupt. If the controller provides one
  interrupt for each GPIO, provide a list of interrupts that correspond to each
  of the GPIO pins. When specifying multiple interrupts, if any are unconnected,
  use the interrupts-extended property to specify the interrupts and set the
  interrupt controller handle for unused interrupts to 0.
- snps,nr-gpios : The number of pins in the port, a single cell.
- snps,has-pinctrl : If present, register the pinctrl controller.
- resets : Reset line for the controller.

Required properties for pin configuration node:
- function: string representing a function to mux for pins
    dw apb controller only has two functions for each pins (sw and hw). When set
    in software mode, the gpio controller controls the pin output. When
    configured in hardware mode, an external peripheral controls the pin signal.
- pins: string array of pins to be muxed.

Example:

gpio: gpio@20000 {
	compatible = "snps,dw-apb-gpio";
	reg = <0x20000 0x1000>;
	#address-cells = <1>;
	#size-cells = <0>;

	porta: gpio@0 {
		compatible = "snps,dw-apb-gpio-port";
		gpio-controller;
		#gpio-cells = <2>;
		snps,nr-gpios = <8>;
		reg = <0>;
		interrupt-controller;
		#interrupt-cells = <2>;
		interrupt-parent = <&vic1>;
		interrupts = <0>;
	};

	portb: gpio@1 {
		compatible = "snps,dw-apb-gpio-port";
		gpio-controller;
		#gpio-cells = <2>;
		snps,nr-gpios = <8>;
		snps,has-pinctrl;
		reg = <1>;

		uart0_pins: pinmux_uart0_pins {
			function = "hw";
			pins = "pin0", "pin1";
		};

		uart1_pins: pinmux_uart1_pins {
			function = "hw";
			pins = "pin2", "pin3";
		};
	};
};
```

## Documentation/devicetree/bindings/soc/kvx/kalray,coolidge-pwr-ctrl.yaml
```yaml
# SPDX-License-Identifier: GPL-2.0-only OR BSD-2-Clause
%YAML 1.2
---
$id: http://devicetree.org/schemas/kalray/kalray,coolidge-pwr-ctrl.yaml#
$schema: http://devicetree.org/meta-schemas/core.yaml#

title: Kalray Coolidge cluster Power Controller (pwr-ctrl)

maintainers:
  - Jonathan Borne <jborne@kalrayinc.com>
  - Julian Vetter <jvetter@kalrayinc.com>
  - Yann Sionneau <ysionneau@kalrayinc.com>

description: |
  The Power Controller (pwr-ctrl) control cores reset and wake-up procedure.

properties:
  compatible:
    const: kalray,coolidge-pwr-ctrl

  reg:
    maxItems: 1

additionalProperties: false

required:
  - compatible
  - reg

examples:
  - |
    pwr_ctrl: pwr-ctrl@a40000 {
        compatible = "kalray,coolidge-pwr-ctrl";
        reg = <0x00 0xa40000 0x00 0x4158>;
    };

...
```

## Documentation/devicetree/bindings/timer/kalray,kv3-1-timer.yaml
```yaml
# SPDX-License-Identifier: GPL-2.0-only OR BSD-2-Clause
%YAML 1.2
---
$id: http://devicetree.org/schemas/timer/kalray,kv3-1-timer.yaml#
$schema: http://devicetree.org/meta-schemas/core.yaml#

title: Kalray kv3-1 core timer

maintainers:
  - Jonathan Borne <jborne@kalrayinc.com>
  - Julian Vetter <jvetter@kalrayinc.com>
  - Yann Sionneau <ysionneau@kalrayinc.com>

description: |
  Timer tightly coupled to the kv3-1 processor core. It is configured via core SFR.
  It triggers an interrupt directly on core-intc.

properties:
  compatible:
    const: kalray,kv3-1-timer

  interrupts-extended:
    maxItems: 16

  clocks:
    maxItems: 1

required:
  - compatible
  - interrupts-extended
  - clocks

additionalProperties: false

examples:
  - |
    core_timer {
        compatible = "kalray,kv3-1-timer";
        clocks = <&core_clk>;
        interrupts-extended = <&core_intc0 0>,
                              <&core_intc1 0>,
                              <&core_intc2 0>,
                              <&core_intc3 0>,
                              <&core_intc4 0>,
                              <&core_intc5 0>,
                              <&core_intc6 0>,
                              <&core_intc7 0>,
                              <&core_intc8 0>,
                              <&core_intc9 0>,
                              <&core_intc10 0>,
                              <&core_intc11 0>,
                              <&core_intc12 0>,
                              <&core_intc13 0>,
                              <&core_intc14 0>,
                              <&core_intc15 0>;
    };
```

## arch/k1c/Kconfig
```kconfig
#
# For a description of the syntax of this configuration file,
# see Documentation/kbuild/kconfig-language.txt.
#

config 64BIT
	def_bool y

config GENERIC_CALIBRATE_DELAY
	def_bool y

config FIX_EARLYCON_MEM
	def_bool y

config MMU
	def_bool y

config KALLSYMS_BASE_RELATIVE
        def_bool n

config GENERIC_CSUM
	def_bool y

config RWSEM_GENERIC_SPINLOCK
	def_bool y

config GENERIC_HWEIGHT
	def_bool y

config HAVE_COPY_THREAD_TLS
	def_bool y

config K1C
	def_bool y
	select OF
	select OF_EARLY_FLATTREE
	select OF_RESERVED_MEM
	select GENERIC_IRQ_CHIP
	select GENERIC_IRQ_PROBE
	select GENERIC_IRQ_SHOW
	select GENERIC_IOMAP
	select GENERIC_CPU_DEVICES
	select GENERIC_CLOCKEVENTS
	select GENERIC_STRNLEN_USER
	select GENERIC_STRNCPY_FROM_USER
	select THREAD_INFO_IN_TASK
	select COMMON_CLK
	select CLKSRC_OF
	select GENERIC_CLOCKEVENTS
	select TIMER_OF
	select K1C_CORE_INTC
	select K1C_APIC_GIC
	select K1C_APIC_MAILBOX
	select K1C_ITGEN
	select SPARSE_IRQ
	select ARCH_WANT_FRAME_POINTERS
	select ARCH_CLOCKSOURCE_DATA
	select HAVE_GENERIC_DMA_COHERENT
	select HAVE_PCI
	select HAVE_ARCH_JUMP_LABEL

config PGTABLE_LEVELS
	int
	default 2 if K1C_64K_PAGES
	default 3

config HAVE_KPROBES
	def_bool n

menu "System setup"

config PANIC_SYSCALL
	bool "Emit a magic syscall in panic"
	default y
	help
	  In order to validate the step where the kernel goes, we need
	  to emit an exit signal if the panic match the expected one.
	  Enabling this option add a panic notifier.

config PANIC_SYSCALL_EXPECTED
        string "Expected panic string"
        depends on PANIC_SYSCALL
        default ""
        help
          Expected string by syscall panic notifier. If panic string
          matches the expected, exit with 0, else exit with 1.

config POISON_INITMEM
	bool "Enable to poison freed initmem"
	default y
        help
          In order to debug initmem, using poison allows to verify if
	  some data/code is stille using them. Enable this for debug
	  purposes

config K1C_PHYS_OFFSET
	hex "RAM address of memory base"
	default 0x100000000

config K1C_PAGE_OFFSET
	hex "kernel virtual address of memory base"
	default 0xFFFFFF8000000000

config STACK_MAX_DEPTH_TO_PRINT
	int "Maximum depth of stack to print"
	range 1 128
	default "24"

config DEBUG_EXCEPTION_STACK
	bool "Enable exception stack debugging"
	default n
	help
	  Enable stack check debugging when entering/exiting
	  exception handlers.
	  This can be particularly helpful after modifying stack
	  handling to see if stack when exiting is the same as the one
	  when entering exception handler.

config SECURE_DAME_HANDLING
	bool "Secure DAME handling"
	default y
	help
	  In order to securely handle Data Asynchronous Memory Errors, we need
	  to do a barrier upon kernel entry when coming from userspace. This
	  barrier guarantee us that any pending DAME will be serviced right
	  away. We also need to do a barrier when returning from kernel to user.
	  This way, if the kernel or the user triggered a DAME, it will be
	  serviced by knowing we are coming from kernel or user and avoid
	  pulling the wrong lever (panic for kernel or sigfault for user).
	  This can be costly but ensure that user cannot interfere with kernel.
	  /!\ Do not disable unless you want to open a giant breach between
	  user and kernel /!\

config NR_CPUS
	int "Maximum number of CPUs"
	range 2 16
	depends on SMP
	help
	  Kalray support can handle a maximum of 16 CPUs.

choice
	prompt "Page size"
	default K1C_4K_PAGES
	help
	  Page size (translation granule) configuration.

config K1C_4K_PAGES
	bool "4KB"
	help
	  This feature
	  enables 4KB
	  pages
	  support.

config K1C_64K_PAGES
	bool "64KB"
	help
	  This feature
	  enables 64KB
	  pages support
	  (4KB by default).

endchoice

config K1C_PAGE_SHIFT
	int
	default 16 if K1C_64K_PAGES
	default 12

config CMDLINE
        string "Default kernel command string"
        default ""
        help
          On some architectures there is currently no way for the boot loader
          to pass arguments to the kernel. For these architectures, you should
          supply some command-line options at build time by entering them
          here.

endmenu

menuconfig K1C_DEBUG
	bool "K1C debugging"
	default y
if K1C_DEBUG
config K1C_DEBUG_ASN
	bool "Check ASN before writing TLB entry"
	default y
	help
	  This option allows to check if the ASN of the current
	  process is matching the ASN found in MMC. If it is not the
	  case an error will be print.

config K1C_DEBUG_TLB_ACCESS_BITS
	int "Number of bits used as index of entries in logged table"
	default 12
	help
	  Set the number of bits used as index of entries that will be logged
	  in a ring buffer called k1c_tlb_access. One entry in the table
	  contains registers TEL, TEH and MMC. It also logs the type of the
	  operations (0:read, 1:write, 2:probe). Buffer is per CPU. For one
	  entry 24 bytes are used. So by default it uses 96Ko of memory per
	  CPU to store 2^12 (4096) entries.
endif

menu "Kernel Features"
source "kernel/Kconfig.hz"
endmenu
```
