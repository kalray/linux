## arch/k1c/Kconfig.debug
```kconfig
menu "K1C debugging"

config K1C_DEBUG_ASN
	bool "Check ASN before writing TLB entry"
	default n
	help
	  This option allows to check if the ASN of the current
	  process is matching the ASN found in MMC. If it is not the
	  case an error will be printed.

config K1C_DEBUG_TLB_WRITE
	bool "Enable TLBs write checks"
	default n
	help
	  Enabling this option will enable TLB access checks. This is
	  particularly helpful when modifying the assembly code responsible
	  of TLB refill. If set, mmc.e will be checked each time the tlb are
	  written and a panic will be thrown on error.

config K1C_DEBUG_TLB_ACCESS
	bool "Enable TLBs accesses logging"
	default n
	help
	  Enabling this option will enable TLB entry manipulation logging.
	  Each time an entry will be added to the TLBs, it will be logged in
	  an array readable via gdb scripts. This can be useful to understand
	  strange crashes related to suspicious virtual/physical addresses.

config K1C_DEBUG_TLB_ACCESS_BITS
	int "Number of bits used as index of entries in log table"
	default 12
	depends on K1C_DEBUG_TLB_ACCESS
	help
	  Set the number of bits used as index of entries that will be logged
	  in a ring buffer called k1c_tlb_access. One entry in the table
	  contains registers TEL, TEH and MMC. It also logs the type of the
	  operations (0:read, 1:write, 2:probe). Buffer is per CPU. For one
	  entry 24 bytes are used. So by default it uses 96Ko of memory per
	  CPU to store 2^12 (4096) entries.

config K1C_MMU_STATS
	bool "Register mmu stats debugfs entries"
	default n
	select DEBUG_FS
	help
	  Enable debugfs attribute which will allow inspecting various metric
	  regarding MMU:
	  - Number of nomapping traps handled
	  - avg/min/max time for nomapping refill (user/kernel)

config DEBUG_EXCEPTION_STACK
	bool "Enable exception stack debugging"
	default n
	help
	  Enable stack check debugging when entering/exiting
	  exception handlers.
	  This can be particularly helpful after modifying stack
	  handling to see if stack when exiting is the same as the one
	  when entering exception handler.

config DEBUG_SFR_SET_MASK
	bool "Enable sfr set_mask debugging"
	default n
	help
	  Verify that values written using k1_sfr_set_mask are matching the
	  mask. This ensure that no extra bits of sfr will be overridden by some
	  incorrectly truncated values. This can lead to huge problems by
	  modifying important bits in system registers.

endmenu
```

## arch/k1c/configs/default_defconfig
```kconfig
CONFIG_DEFAULT_HOSTNAME="K1Clinux"
CONFIG_EMBEDDED=y
CONFIG_SERIAL_K1C_SCALL_COMM=y
CONFIG_DEBUG_KERNEL=y
CONFIG_DEBUG_INFO=y
CONFIG_DEBUG_INFO_DWARF4=y
CONFIG_PRINTK_TIME=y
CONFIG_CONSOLE_LOGLEVEL_DEFAULT=15
CONFIG_MESSAGE_LOGLEVEL_DEFAULT=7
CONFIG_PANIC_TIMEOUT=-1
CONFIG_BLK_DEV_INITRD=y
CONFIG_GDB_SCRIPTS=y
CONFIG_FRAME_POINTER=y
CONFIG_HZ_100=y
CONFIG_SERIAL_EARLYCON=y
CONFIG_SERIAL_8250=y
CONFIG_SERIAL_8250_CONSOLE=y
CONFIG_SERIAL_8250_DW=y
CONFIG_PINCTRL=y
CONFIG_PINCTRL_SINGLE=y
CONFIG_JUMP_LABEL=y
CONFIG_PCI=y
CONFIG_PCI_MSI=y
CONFIG_PCIE_K1C_NWL=y
CONFIG_PCIEPORTBUS=y
# CONFIG_PCIEASPM is not set
CONFIG_PCIEAER_INJECT=y
CONFIG_TMPFS=y
CONFIG_DMADEVICES=y
CONFIG_K1C_DMA_NOC=y
CONFIG_K1C_IOMMU=y
CONFIG_PACKET=y
CONFIG_NET=y
# CONFIG_WLAN is not set
CONFIG_INET=y
CONFIG_IPV6=y
CONFIG_NETDEVICES=y
CONFIG_NET_CORE=y
CONFIG_E1000E=y
CONFIG_BLK_DEV_NVME=y
CONFIG_VFAT_FS=y
CONFIG_NLS_DEFAULT="iso8859-1"
CONFIG_NLS_CODEPAGE_437=y
CONFIG_NLS_ISO8859_1=y
CONFIG_WATCHDOG=y
CONFIG_K1C_WATCHDOG=y
CONFIG_HUGETLBFS=y
CONFIG_MAILBOX=y
CONFIG_K1C_MBOX=y
CONFIG_REMOTEPROC=y
CONFIG_K1C_REMOTEPROC=y
CONFIG_RPMSG_VIRTIO=y
CONFIG_RPMSG_CHAR=y
CONFIG_MODULES=y
CONFIG_MODULE_UNLOAD=y
CONFIG_MODVERSIONS=y
CONFIG_MODULE_SRCVERSION_ALL=y
CONFIG_BLK_DEV=y
CONFIG_BLK_DEV_LOOP=m
CONFIG_BLK_DEV_LOOP_MIN_COUNT=8
CONFIG_EXT4_FS=m
CONFIG_EXT4_USE_FOR_EXT2=y
```

## arch/kvx/Kconfig
```kconfig
#
# For a description of the syntax of this configuration file,
# see Documentation/kbuild/kconfig-language.txt.
#

config 64BIT
	def_bool y

config GENERIC_CALIBRATE_DELAY
	def_bool y

config FIX_EARLYCON_MEM
	def_bool y

config MMU
	def_bool y

config SYS_SUPPORTS_HUGETLBFS
	def_bool y

config KALLSYMS_BASE_RELATIVE
        def_bool n

config GENERIC_CSUM
	def_bool y

config RWSEM_GENERIC_SPINLOCK
	def_bool y

config GENERIC_HWEIGHT
	def_bool y

config HAVE_COPY_THREAD_TLS
	def_bool y

config ZONE_DMA32
	def_bool n

config STACKTRACE_SUPPORT
	def_bool y

config LOCKDEP_SUPPORT
	def_bool y

config TRACE_IRQFLAGS_SUPPORT
	def_bool y

config GENERIC_BUG
	def_bool y
	depends on BUG

config KVX
	def_bool y
	select OF
	select OF_EARLY_FLATTREE
	select OF_RESERVED_MEM
	select GENERIC_IRQ_CHIP
	select GENERIC_IRQ_PROBE
	select GENERIC_IRQ_SHOW
	select GENERIC_IOMAP
	select GENERIC_IOREMAP
	select GENERIC_CPU_DEVICES
	select GENERIC_CLOCKEVENTS
	select GENERIC_STRNLEN_USER
	select GENERIC_STRNCPY_FROM_USER
	select THREAD_INFO_IN_TASK
	select COMMON_CLK
	select CLKSRC_OF
	select GENERIC_CLOCKEVENTS
	select TIMER_OF
	select KVX_CORE_INTC
	select KVX_APIC_GIC
	select KVX_APIC_MAILBOX
	select KVX_ITGEN
	select SPARSE_IRQ
	select ARCH_WANT_FRAME_POINTERS
	select ARCH_CLOCKSOURCE_DATA
	select GENERIC_ALLOCATOR
	select ARCH_HAS_PTE_SPECIAL
	select DMA_DIRECT_REMAP
	select HAVE_PCI
	select HAVE_ARCH_JUMP_LABEL
	select HAVE_ARCH_TRACEHOOK
	select HAVE_ARCH_AUDITSYSCALL
	select HAVE_EFFICIENT_UNALIGNED_ACCESS
	select HAVE_ASM_MODVERSIONS
	select ZONE_DMA32
	select SYSCTL_EXCEPTION_TRACE
	select ARCH_USE_QUEUED_SPINLOCKS
	select ARCH_USE_QUEUED_RWLOCKS
	select HAVE_MEMBLOCK_NODE_MAP
	select HAVE_ARCH_BITREVERSE
	select ARCH_HAS_DEVMEM_IS_ALLOWED
	select ARCH_DMA_ADDR_T_64BIT
	select ARCH_HAS_SYNC_DMA_FOR_DEVICE
	select ARCH_HAS_SYNC_DMA_FOR_CPU
	select HAVE_SYSCALL_TRACEPOINTS
	select ARCH_HAS_STRICT_KERNEL_RWX
	select ARCH_HAS_STRICT_MODULE_RWX
	select ARCH_OPTIONAL_KERNEL_RWX_DEFAULT
	select IOMMU_DMA if IOMMU_SUPPORT
	select ARCH_HAS_SETUP_DMA_OPS if IOMMU_SUPPORT
	select ARCH_HAS_TEARDOWN_DMA_OPS if IOMMU_SUPPORT
	select ARCH_HAS_DMA_PREP_COHERENT
	select ARCH_HAS_DMA_MMAP_PGPROT
	select PERF_EVENTS
	select HAVE_PERF_EVENTS
	select HAVE_HW_BREAKPOINT
	select MODULES_USE_ELF_RELA
	select HAVE_STACKPROTECTOR
	select HAVE_ARCH_TRANSPARENT_HUGEPAGE
	select PCI_DOMAINS_GENERIC if PCI

config PGTABLE_LEVELS
	int
	default 3

config HAVE_KPROBES
	def_bool n

menu "System setup"

config POISON_INITMEM
	bool "Enable to poison freed initmem"
	default y
        help
          In order to debug initmem, using poison allows to verify if
	  some data/code is stille using them. Enable this for debug
	  purposes

config KVX_PHYS_OFFSET
	hex "RAM address of memory base"
	default 0x100000000

config KVX_PAGE_OFFSET
	hex "kernel virtual address of memory base"
	default 0xFFFFFF8000000000

config STACK_MAX_DEPTH_TO_PRINT
	int "Maximum depth of stack to print"
	range 1 128
	default "24"

config L2_CACHE
	bool "Enable l2 cache driver"
	default y
	help
	  Enable L2 cache driver in order to handle it. This driver can be
	  disabled to eliminate any overhead related to L2 cache
	  inval/writeback. Note that L2 cache is mandatory for SMP in order
	  to maintain coherency on DDR between all PEs.

config SECURE_DAME_HANDLING
	bool "Secure DAME handling"
	default y
	help
	  In order to securely handle Data Asynchronous Memory Errors, we need
	  to do a barrier upon kernel entry when coming from userspace. This
	  barrier guarantee us that any pending DAME will be serviced right
	  away. We also need to do a barrier when returning from kernel to user.
	  This way, if the kernel or the user triggered a DAME, it will be
	  serviced by knowing we are coming from kernel or user and avoid
	  pulling the wrong lever (panic for kernel or sigfault for user).
	  This can be costly but ensure that user cannot interfere with kernel.
	  /!\ Do not disable unless you want to open a giant breach between
	  user and kernel /!\

config ENABLE_TCA
	bool "Enable TCA coprocessor support"
	default y
	help
	  This option enables TCA coprocessor support. It will allow the user to
	  use the coprocessor and save registers on context switch if used.
	  Registers content will also be cleared when switching.

config SMP
	bool "Symmetric multi-processing support"
	default n
	select GENERIC_SMP_IDLE_THREAD
	select GENERIC_IRQ_IPI
	select IRQ_DOMAIN_HIERARCHY
	select IRQ_DOMAIN
	select L2_CACHE
	help
	  This enables support for systems with more than one CPU. If you have
	  a system with only one CPU, say N. If you have a system with more
	  than one CPU, say Y.

	  If you say N here, the kernel will run on uni- and multiprocessor
	  machines, but will use only one CPU of a multiprocessor machine. If
	  you say Y here, the kernel will run on many, but not all,
	  uniprocessor machines. On a uniprocessor machine, the kernel
	  will run faster if you say N here.

config NR_CPUS
	int "Maximum number of CPUs"
	range 1 16
	default "16"
	depends on SMP
	help
	  Kalray support can handle a maximum of 16 CPUs.

choice
	prompt "Page size"
	default KVX_4K_PAGES
	help
	  Page size (translation granule) configuration.

config KVX_4K_PAGES
	bool "4KB"
	help
	  This feature
	  enables 4KB
	  pages
	  support.

config KVX_64K_PAGES
	bool "64KB"
	help
	  This feature
	  enables 64KB
	  pages support
	  (4KB by default).

endchoice

config KVX_PAGE_SHIFT
	int
	default 16 if KVX_64K_PAGES
	default 12

config CMDLINE
        string "Default kernel command string"
        default ""
        help
          On some architectures there is currently no way for the boot loader
          to pass arguments to the kernel. For these architectures, you should
          supply some command-line options at build time by entering them
          here.

endmenu

menu "Kernel Features"
source "kernel/Kconfig.hz"
endmenu
```

## arch/kvx/Kconfig.debug
```kconfig
menu "KVX debugging"

config KVX_DEBUG_ASN
	bool "Check ASN before writing TLB entry"
	default n
	help
	  This option allows to check if the ASN of the current process matches
	  the ASN found in MMC. If it is not the case an error will be printed.

config KVX_DEBUG_TLB_WRITE
	bool "Enable TLBs write checks"
	default n
	help
	  Enabling this option will enable TLB access checks. This is
	  particularly helpful when modifying the assembly code responsible for
	  the TLB refill. If set, mmc.e will be checked each time the TLB is
	  written and a panic will be thrown on error.

config KVX_DEBUG_TLB_ACCESS
	bool "Enable TLBs accesses logging"
	default n
	help
	  Enabling this option will enable TLB entry manipulation logging.
	  Each time an entry is added to the TLBs, it will be logged in an
	  array readable via gdb scripts. This can be useful to understand
	  crashes related to suspicious virtual/physical addresses.

config KVX_DEBUG_TLB_ACCESS_BITS
	int "Number of bits used as index of entries in log table"
	default 12
	depends on KVX_DEBUG_TLB_ACCESS
	help
	  Set the number of bits used as index of entries that will be logged
	  in a ring buffer called kvx_tlb_access. One entry in the table
	  contains registers TEL, TEH and MMC. It also logs the type of the
	  operations (0:read, 1:write, 2:probe). Buffer is per CPU. For one
	  entry 24 bytes are used. So by default it uses 96KB of memory per
	  CPU to store 2^12 (4096) entries.

config KVX_MMU_STATS
	bool "Register MMU stats debugfs entries"
	default n
	select DEBUG_FS
	help
	  Enable debugfs attribute which will allow inspecting various metrics
	  regarding the MMU:
	  - Number of nomapping traps handled
	  - avg/min/max time for nomapping refill (user/kernel)

config DEBUG_SFR_SET_MASK
	bool "Enable sfr set_mask debugging"
	default n
	help
	  Verify that values written using kvx_sfr_set_mask are matching the
	  mask. This ensure that no extra bits of sfr will be overridden by
	  incorrectly truncated values, which can lead to problems by modifying
	  important bits in system registers.

endmenu
```

## drivers/net/ethernet/kalray/Kconfig
```kconfig
#
# Kalray device configuration
#

config NET_VENDOR_KALRAY
	bool "Kalray devices"
	default y
	help
	  If you have a network (Ethernet) card belonging to this class, say Y.

	  Note that the answer to this question doesn't directly affect the
	  kernel: saying N will just cause the configurator to skip all
	  the questions about Kalray cards. If you say Y, you will be asked for
	  your specific card in the following questions.

if NET_VENDOR_KALRAY
config NET_KVX_SOC
	tristate "Kalray ethernet support"
	depends on KVX_DMA_NOC
	depends on I2C
	select PAGE_POOL
	select NET_TI_RTM
	help
	  This driver supports the KVX Ethernet hardware using dma_noc driver
	  as dependency.
	  Allows configuring load balancing (flow control, parsing) and
	  TX flow.

	  To compile this driver as a module, choose M here.

config NET_KVX_QSFP
	tristate "Kalray QSFP cage support"
	select I2C

endif # NET_VENDOR_KALRAY
```

## drivers/net/retimer/Kconfig
```kconfig
#
# Retimer device configuration
#

config NET_TI_RTM
	tristate "TI DS2x0DFx10 retimer support"
	depends on I2C
	help
	  This driver supports the Texas Instruments DS2x0DFx10 retimer
	  hardware family (DS280DF810, DS250DF810 and DS250DF410). Say Y if you
	  want to use this driver to configure retimers.

	  To compile this driver as a module, choose M here.
```

## drivers/pinctrl/dw/Kconfig
```kconfig
config GPIO_DWAPB
	tristate "Synopsys DesignWare APB Pinctrl & GPIO driver"
	select GPIOLIB
	select GPIOLIB_IRQCHIP
	select GPIO_GENERIC
	select PINMUX
	select GENERIC_PINCONF
	help
	  Say Y or M here to build support for the Synopsys DesignWare APB
	  GPIO block.
```

## drivers/soc/kvx/Kconfig
```kconfig
# SPDX-License-Identifier: GPL-2.0

config COOLIDGE_POWER_CONTROLLER
	bool "Coolidge power controller"
	default n
	depends on KVX
	help
	  The Kalray Coolidge Power Controller is used to manage the power
	  state of secondary CPU cores. Currently only powering up is
	  supported.
```
