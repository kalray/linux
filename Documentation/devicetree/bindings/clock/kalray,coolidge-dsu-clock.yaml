## Documentation/devicetree/bindings/net/kalray,kvx-net.txt
```
* Kalray net controller

Required properties:
- compatible: Should be "kalray,kvx-eth"
- reg: {phy, phymac, mac, eth} registers and length
- reg-names: {phy, phymac, mac, eth} names

Optional properties:
- cell-index: ethernet hw index, used for packet routing

* Kalray netdev

Required properties:
- compatible: Should be "kalray,kvx-net";
- dmas: tx dma-noc channels
- dma-names: as defined in bindings/dma/dma.txt
- kalray,dma-rx-cache-id: dma pool of RX buffers [0, 3]
- kalray,dma-rx-channel-ids: start index of RX channel followed by number
- kalray,dma-rx-comp-queue-ids: start index of RX completion queue followed by number
- kalray,phy-param: phy parameters for Tx equalization, as follow:
  <tx pre-amp, tx post-amp, tx swing, rx polarity, tx polarity>
- sfp: sfp definition
- fixed-link: as defined in bindings/net/ethernet-controller.yaml

Example:

	qsfp0:qsfp0@0 {
		compatible = "sff,qsfp";
		i2c-bus = <&i2c0>;
		mod-def0-gpios = <&gpio1_banka 26 GPIO_ACTIVE_LOW>;
		tx-disable-gpios = <&gpio1_banka 28 GPIO_ACTIVE_HIGH>;
	};

	eth0: ethernet@10050000 {
		eth0: ethernet@10050000 {
			compatible = "kalray,kvx-eth";
			reg = <0x0 0x10000000 0x0 0x3FFFF>,
			    <0x0 0x10040000 0x0 0xB4>,
			    <0x0 0x10050000 0x0 0x8ED0>,
			    <0x0 0x10090000 0x0 0x16400>;
			reg-names = "phy", "phymac", "mac", "eth";
			cell-index = <0>;

			port0: ethernet-port@0 {
				compatible = "kalray,kvx-net";
				dmas = <&dma_noc 1>;
				dma-names = "tx";
				kalray,dma-rx-cache-id = <0>;
				kalray,dma-rx-channel-ids = <0 1>;
				kalray,dma-rx-comp-queue-ids = <0 1>;
				kalray,phy-param = <0 0 40 0 0>;
				phy-mode = "internal";
				sfp = <&qsfp0>;
				fixed-link {
					speed = <40000>;
					full-duplex;
				};
			};
		};
	};
```

## Documentation/devicetree/bindings/net/kalray,kvx-qsfp.txt
```
 * Kalray qsfp

Required properties:
- compatible: Should be "kalray,qsfp"
- i2c-bus: i2c bus of qsfp module
- mod-def0-gpios: module presence gpio
- tx-disable-gpios: TX disable gpio

Optional properties:
- maximum-power-milliwatt: max qsfp module power in mW
- reset-gpios: qsfp reset gpio (to force reset for QSFP not implementing this in EEPROM)
- kalray,qsfp-param: <page offset value ...> table for qsfp eeprom

Example:
	qsfp0:qsfp0@0 {
		compatible = "kalray,qsfp";
		i2c-bus = <&i2c0>;
		mod-def0-gpios = <&gpio1_banka 26 GPIO_ACTIVE_LOW>;
		tx-disable-gpios = <&gpio1_banka 28 GPIO_ACTIVE_HIGH>;
		maximum-power-milliwatt = <3500>;
		reset-gpios = <&gpio1_banka 27 GPIO_ACTIVE_LOW>;
		/* qsfp param: <page, offset, value> */
		kalray,qsfp-param = <3 241 0x0>, /* Tx adaptive equalization + Rx output */
			<3 236 0x0>, /* Rx output emphasis control */
			<3 237 0x0>, /* Rx output emphasis control */
			<3 238 0x33>, /* Rx output amplitude control */
			<3 239 0x33>; /* Rx output amplitude control */
	      };
```

## Documentation/devicetree/bindings/net/ti,retimer.txt
```
* TI retimer

Required properties:
- compatible: Should be "ti,retimer"
- reg: Address on i2c bus
- en_smb_gpios: RX/TX slave enable gpio
  Z for E2PROM mode, 1 for I2C slave
- ti,reg-init: I2C init sequence

Optional:
- read-en-gpios: Read enable gpio
  if en_smb = Z, read enable must be 0 for E2PROM master mode
  if en_smb = 1, 0 for reset, 1 for normal operation
- done-gpios: All done gpio
  if en_smb = 1, this gpio has the same value as read_en_gpio
  if en_smb = 0, 0 is E2PROM success, 1 is E2PROM fail

Example:

axi {
	i2c3: i2c@20198000 {
		#address-cells = <1>;
		#size-cells = <0>;
		rtmrx: rtmrx@18 {
			compatible = "ti,retimer";
			reg = <0x18>;
			en-smb-gpios = <&gpio0_banka 9 0>;
			read-en-gpios = <&gpio1_banka 19 0>;
			/* register address, offset, mask, value */
			ti,reg-init = <0x1 0 0xff 0x0>;
		};
	};
};
```

## Documentation/devicetree/bindings/pci/kalray,k1c-pcie-rc.txt
```
* Kalray NWL PCIe Root Port Bridge DT description

Required properties:
- compatible: Should contain "k1c,k1c-pcie-rc"
- #address-cells: Address representation for root ports, set to <3>
- #size-cells: Size representation for root ports, set to <2>
- #interrupt-cells: specifies the number of cells needed to encode an
	interrupt source. The value must be 1.
- reg: Should contain Bridge, CSR, bar decoder, ecam, phycore, ftu physical
  address and length
- reg-names: Must include the following entries:
	"dma_bridge_reg": bridge registers
	"csr_reg": core status registers
	"bar_decoder_reg": bar decoder registers region
	"phycore_reg": PCIe phy configuration registers region
	"ftu_reg": ftu registers region
	"ecam_reg": configuration space region
- device_type: must be "pci"
- interrupts: Should contain misc and legacy interrupt number
- interrupt-names: Must include the following entries:
	"intx": interrupt asserted when a legacy interrupt is received
	"misc": interrupt asserted when miscellaneous interrupt is received
- interrupt-map-mask and interrupt-map: standard PCI properties to define the
	mapping of the PCI interface to interrupt numbers.
- ranges: ranges for the PCI memory regions (I/O space region is not
	supported by hardware)
	Please refer to the standard PCI bus binding document for a more
	detailed explanation
- legacy-interrupt-controller: Interrupt controller device node for Legacy
	interrupts
	- interrupt-controller: identifies the node as an interrupt controller
	- #interrupt-cells: should be set to 1
	- #address-cells: specifies the number of cells needed to encode an
		address. The value must be 0.
- kalray,nb-lane : define the number of PCIe lane used by the root complex
- kalray,disable-dame : when not 0, prevent the generation of a DAME error if a
	PCIe transaction failed. Disabling the DAME keep the system alive even
	in case of PCIe fatal error which allows to perform an error analysis with
	AER, but in a production system this might cause some serious errors to
	be silently ignored.

Example:
++++++++

pcie: pcie@0x112fd00000 {
	compatible = "kalray,k1c-pcie-rc";
	#address-cells = <3>;
	#size-cells = <2>;
	#interrupt-cells = <1>;
	device_type = "pci";
	kalray,nb-lane = <8>;
	kalray,disable-dame = <0>;
	reg = <0x51 0x2FD00000 0x0 0x40000>, /* Expresso dma bridge register mapping*/
		  <0x51 0x28100000 0x0 0x40000>, /* Expresso core register mapping */
		  <0x51 0x28340000 0x0 0x10000>, /* Bar decoder (essentially to disable it)*/
		  <0x51 0x30000000 0x0 0x10000000>, /* ECAM region mapping */
		  <0x51 0x28300200 0x0 0x1000>, /* phy core region mapping */
		  <0x40 0x10181000 0x0 0x1000>; /* FTU region mapping */

	reg-names = "dma_bridge_reg", "csr_reg", "bar_decoder_reg", "ecam_reg", "phycore_reg", "ftu_reg";
			 /* flags */ /* pci addr 64 bits*/ /*mppa addr 64 bits*/ /*    region size  */
	ranges = <0x02000000 0x00000000 0x80000000 0x00000053 0xA0000000 0x00000000 0x10000000	/* non-prefetchable memory, 32 bits only*/
		  0x43000000 0x00000012 0x00000000 0x00000052 0x00000000 0x00000001 0x80000000>;  /* prefetchable memory*/
	bus-range = <0x00 0xff>;
	interrupt-map-mask = <0x0 0x0 0x0 0x7>;
	interrupt-map = <0x0 0x0 0x0 0x1 &pcie_intc 0x1>,
			<0x0 0x0 0x0 0x2 &pcie_intc 0x2>,
			<0x0 0x0 0x0 0x3 &pcie_intc 0x3>,
			<0x0 0x0 0x0 0x4 &pcie_intc 0x4>;
	interrupt-parent = <&itgen_misc>;
	interrupts = <2>, <3>;
	interrupt-names = "intx", "misc";
	pcie_intc: legacy-interrupt-controller {
		interrupt-controller;
		#address-cells = <0>;
		#interrupt-cells = <1>;
	};
};
```

## Documentation/devicetree/bindings/pci/kalray,kvx-pcie-rc.txt
```
* Kalray NWL PCIe Root Port Bridge DT description

The configuration of root complex is done in two differents nodes with
following structure :

pcie_subsys: XXXX {
	/**
	 * define properties common to all root complex
	 * Cf. kalray,subsys-pcie.txt
	 */

	pcie0: XXXX {
		/* definitions specific to root complex 0 */
	}

	...
	/* depending on nfurcation configuration up to 8 root complex might be
	 * present */
	...

	pcie7 : XXXX {
		/* definitions specific to root complex 7 */
	}
}

Required properties for pcie nodes:
This node define the properties of a single root complex.
(Depending on n-furcation there is up to 8 PCIe controller, thus this node may
be present several times)
- compatible: Should contain "kvx,kvx-pcie-rc"
- #address-cells: Address representation for root ports, set to <3>
- #size-cells: Size representation for root ports, set to <2>
- #interrupt-cells: specifies the number of cells needed to encode an
	interrupt source. The value must be 1.
- reg: Should contain Bridge, CSR, ecam physical address and length
- reg-names: Must include the following entries:
	"bridge_reg": bridge registers
	"csr_reg": core status registers
	"ecam_reg": configuration space region
	"bar_decoder": required only for controller 0, bar decoder region
- kalray,ctrl-num : the index of the controller
- kalray,ftu-dev : must contain a reference to syscon ftu device
- kalray,phycore-dev : must contain a reference to syscon phycore device
 device_type: must be "pci"
- interrupts: Should contain misc and legacy interrupt number
- interrupt-names: Must include the following entries:
	"intx": interrupt asserted when a legacy interrupt is received
	"misc": interrupt asserted when miscellaneous interrupt is received
- interrupt-map-mask and interrupt-map: standard PCI properties to define the
	mapping of the PCI interface to interrupt numbers.
- ranges: ranges for the PCI memory regions (I/O space region is not
	supported by hardware)
	Please refer to the standard PCI bus binding document for a more
	detailed explanation
- legacy-interrupt-controller: Interrupt controller device node for Legacy
	interrupts
	- interrupt-controller: identifies the node as an interrupt controller
	- #interrupt-cells: should be set to 1
	- #address-cells: specifies the number of cells needed to encode an
		address. The value must be 0.
- linux,pci-domain : define the index of the domain, when there is several root
    complex use a different number for each one, use 0 when there is only one
	root comples.
- kalray,nb-lane : define the number of PCIe lane used by the root complex

Example 1: use default configuration set by first stage boot loader (1X16)
++++++++++++++++++++++++++++++++++++++++++++++++++++++++++++++++++++++++++

/* define iommu shared by all root complex controllers */
iommu_pci: iommu@5128401000 {
	compatible = "kalray,kvx-iommu";
	reg = <0x51 0x28401000 0x0 0x00000240>,
	      <0x51 0x28400000 0x0 0x00000240>;
	reg-names = "tx", "rx";
	interrupts = <101>, <102>, <103>,
		     <86>, <87>, <88>;
	interrupt-names = "tx_nomapping", "tx_protection", "tx_parity",
			  "rx_nomapping", "rx_protection", "rx_parity";
	interrupt-parent = <&itgen_misc>;
	#iommu-cells = <1>;
};

/* map ASN registers used by all root complex controllers */
pcie_rc_asn: pcie_rc_asn@5128500000 {
	compatible = "syscon";
	reg = <0x51 0x28500000 0x0 0x100000>;
};

/* map phy core registers used by all root complex controllers */
pcie_rc_phycore: pcie_rc_phycore@5128300000 {
	compatible = "syscon";
	reg = <0x51 0x28300000 0x0 0x1000>;
};

pcie_subsys: pcie_subsys@5128350000 {
	compatible = "kalray,subsys-pcie";
	reg = <0x51 0x28350000 0x0 0x1000>; /* pcie subsystem */
	reg-names = "pcie_subsys";
	kalray,ftu-dev = <&ftu>;
	kalray,phycore-dev = <&pcie_rc_phycore>;
	kalray,disable-dame = <0>; /* if 1 do not generate DAME when read access fail */
	#address-cells = <2>;
	#size-cells = <2>;
	ranges;

	pcie: pcie@512fd00000 {
		compatible = "kalray,kvx-pcie-rc";
		kalray,mst-asn-dev = <&pcie_rc_asn>;
		kalray,ftu-dev = <&ftu>;
		kalray,phycore-dev = <&pcie_rc_phycore>;
		kalray,ctrl-num = <0>;
		linux,pci-domain=<0>;
		#address-cells = <3>;
		#size-cells = <2>;
		#interrupt-cells = <1>;
		device_type = "pci";
		msi-parent = <&pcimsi_ctrl>;
		iommu-map = <0x0 &iommu_pci 0x0 0x10000>;
		iommu-map-mask = <0x0000>;
		kalray,nb-lane = <8>;
		reg = <0x51 0x2FD00000 0x0 0x40000>, /* Expresso dma bridge register mapping*/
			  <0x51 0x28100000 0x0 0x40000>, /* Expresso core register mapping */
			  <0x51 0x28340000 0x0 0x10000>, /* Bar decoder (essentially to disable it)*/
			  <0x51 0x30000000 0x0 0x10000000>; /* ECAM region mapping */
		reg-names = "bridge_reg", "csr_reg", "bar_decoder_reg", "ecam_reg";
		ranges = <0x02000000 0x00000000 0x00000000 0x00000052 0x00000000 0x00000000 0x10000000	/* non-prefetchable memory, 32 bits only*/
			  0x43000000 0x00000052 0x00000000 0x00000053 0x00000000 0x00000001 0x80000000>;  /* prefetchable memory*/
		bus-range = <0x00 0xff>;
		interrupt-map-mask = <0x0 0x0 0x0 0x7>;
		interrupt-map = <0x0 0x0 0x0 0x1 &pcie_intc 0x1>,
				<0x0 0x0 0x0 0x2 &pcie_intc 0x2>,
				<0x0 0x0 0x0 0x3 &pcie_intc 0x3>,
				<0x0 0x0 0x0 0x4 &pcie_intc 0x4>;
		interrupt-parent = <&itgen_misc>;
		interrupts = <2>, <3>;
		interrupt-names = "intx", "misc";
		pcie_intc: legacy-interrupt-controller {
			interrupt-controller;
			#address-cells = <0>;
			#interrupt-cells = <1>;
		};
	};
};


Example 2: Override default settings, reset PHY and force 2X8 n-furcation
+++++++++++++++++++++++++++++++++++++++++++++++++++++++++++++++++++++++++
Most field are similar to example 1. Most field have a similar meaning to those
shown in example 1. The example bellow only show the fields that override the
values already set by the first stage bootloader. These field should only be
used for test or debug purpose.

pcie_subsys: pcie_subsys@5128350000 {
	...
	/* Cf. kalray,subsys-pcie.txt */
	kalray,force-phy-rst = <1>; /* when 1 force reset on all PCIe PHYs */
	kalray,ovrd-nfurc = <1>; /* if present define n-furcation mode --> 1 = 2X8*/

	pcie0: pcie@512fd00000 {
		...
		kalray,ctrl-num = <0>;
		linux,pci-domain = <0>; /* define PCI domain (it is recommended to use the controller num ) */
		...
	};
	pcie4: pcie@512fe00000 {
		...
		kalray,ctrl-num = <4>; /* in 2X8 n-furcation the second controller being used it the 4th one*/
		linux,pci-domain = <4>; /* This number MUST be different than other controllers one */
		...
	};
};
```
