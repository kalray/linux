## Documentation/devicetree/bindings/clock/kalray,coolidge-dsu-clock.yaml
```yaml
# SPDX-License-Identifier: GPL-2.0-only OR BSD-2-Clause
%YAML 1.2
---
$id: http://devicetree.org/schemas/clock/kalray,coolidge-dsu-clock.yaml#
$schema: http://devicetree.org/meta-schemas/core.yaml#

title: Kalray Coolidge DSU Clock

maintainers:
  - Jonathan Borne <jborne@kalrayinc.com>
  - Julian Vetter <jvetter@kalrayinc.com>
  - Yann Sionneau <ysionneau@kalrayinc.com>

description: |
  DSU Clock is a free running counter that runs at Cluster clock frequency.

properties:
  compatible:
    const: kalray,coolidge-dsu-clock

  reg:
    maxItems: 1

  clocks:
    maxItems: 1

required:
  - reg
  - clocks

additionalProperties: false

examples:
  - |
    dsu_clock@a44180 {
        compatible = "kalray,coolidge-dsu-clock";
        reg = <0x00 0xa44180 0x00 0x08>;
        clocks = <&core_clk>;
    };
```

## Documentation/devicetree/bindings/dma/kalray,k1c-dma-noc-test.txt
```
* Kalray DMA NOC controller tests

Required properties:
- compatible: Should be "kalray,k1c-dma-noc-test"
- dmas: dma_noc used
- dma-names: dma name
- iommus: if defined, same iommu for dma_noc

Example:

/* DMA NOC*/
test_dmaengine@0 {
	compatible = "kalray,k1c-dma-noc-test";
	dmas = <&dma_noc 1>;
	dma-names = "k1c-dma-noc";
	iommus = <&iommu_noc>;
};
```

## Documentation/devicetree/bindings/dma/kalray,k1c-dma-noc.txt
```
* Kalray DMA NOC controller

The K1C DMA controller has 64 RX/TX channels.

Required properties:
- compatible: Should be "kalray,k1c-dma-noc"
- reg: DMA NOC registers and length
- dma-channels: number of used channels
- dma-requests: max number of requests per channel
- msi-parent: mailbox use for MSI
- memory-region: optional reserved region for dma queue allocation
- iommus: optional iommu

Example:

	dma_noc: dma_noc@0x800000 {
		 compatible = "kalray,k1c-dma-noc";
		 #dma-cells = <1>;
		 reg = <0 0x1800000 0 0x100000>;
		 dma-channels = <128>;
		 dma-requests = <32>;
		 msi-parent = <&apic_mailbox>;
		 memory-region = <&dma_noc_reserved>;
		 iommus = <&iommu_noc 12>;
	};

* DMA client

DMA clients connected to the Kalray DMA NOC controller must use the format
described in the dma.txt file, using a one-cell specifier for each channel:

1. Channel id (for RX channel, it also specifies the rx_tag of the channel)

Usage :
  - dmas: <&dma_noc id> arg id is the channel id per direction
  - dma-names: direction "rx"/"tx"

Example:

	mac: mac@10050000 {
		dmas = <&dma_noc 1>,  <&dma_noc 1>;
		dma-names = "rx", "tx";
	};

Channel can then be requested using:
   of_dma_request_slave_channel(of_node, (dir == K1C_DMA_DIR_TYPE_RX ? "rx" : "tx"));
```

## Documentation/devicetree/bindings/dma/kalray,kvx-dma-noc-test.txt
```
* Kalray DMA NOC controller tests

Required properties:
- compatible: Should be "kalray,kvx-dma-noc-test"
- dmas: dma_noc used
- dma-names: dma name

Example:

/* DMA NOC*/
test_dmaengine@0 {
	compatible = "kalray,kvx-dma-noc-test";
	dmas = <&dma_noc 1>;
	dma-names = "kvx-dma-noc";
};
```

## Documentation/devicetree/bindings/dma/kalray,kvx-dma-noc.txt
```
* Kalray DMA NOC controller

The KVX DMA controller has 64 RX/TX channels.

Required properties:
- compatible: Should be "kalray,kvx-dma-noc"
- reg: DMA NOC registers and length
- dma-channels: number of used channels
- dma-requests: max number of requests per channel
- kalray,dma-ucode-ids: start identifier (inclusive) and number of identifiers
  reserved for dma engine microcode firmwares in dma memory
- kalray,dma-ucode-reg: start offset in program table followed by size
- kalray,dma-tx-job-queue-ids: start index of TX job queue followed by number
- kalray,dma-tx-comp-queue-ids: start index of TX completion queue followed by
                                number. Must be inline with dma-tx-job-queue-ids
- kalray,dma-noc-route-ids: usable indexes in noc-route table (start, nb)
- kalray,dma-noc-vchan: hw vchan (MUST be different of vchan used by l2-cache)
- msi-parent: mailbox use for MSI
- memory-region: optional reserved region for dma queue allocation
- iommus: optional iommu

Example:

	dma_noc: dma_noc@0x800000 {
		 compatible = "kalray,kvx-dma-noc";
		 #dma-cells = <1>;
		 reg = <0 0x1800000 0 0x100000>;
		 dma-channels = <128>;
		 dma-requests = <32>;
		 kalray,dma-ucode-ids = <0 3>;
		 kalray,dma-ucode-reg = <0 64>;
		 kalray,dma-tx-job-queue-ids = <0 63>;
		 kalray,dma-tx-comp-queue-ids = <0 63>;
		 kalray,dma-noc-route-ids = <0 511>;
		 kalray,dma-noc-vchan = <1>;
		 msi-parent = <&apic_mailbox>;
		 memory-region = <&dma_noc_reserved>;
		 iommus = <&iommu_noc 12>;
	};

* DMA client

DMA clients connected to the Kalray DMA NOC controller must use the format
described in the dma.txt file, using a one-cell specifier for each channel:

1. Channel id (for RX channel, it also specifies the rx_tag of the channel)

Usage :
  - dmas: <&dma_noc id> arg id is the channel id per direction
  - dma-names: direction "rx"/"tx"

Example:

	mac: mac@10050000 {
		dmas = <&dma_noc 1>,  <&dma_noc 1>;
		dma-names = "rx", "tx";
	};

Channel can then be requested using:
   of_dma_request_slave_channel(of_node, (dir == KVX_DMA_DIR_TYPE_RX ? "rx" : "tx"));
```

## Documentation/devicetree/bindings/interrupt-controller/kalray,coolidge-apic-gic.yaml
```yaml
# SPDX-License-Identifier: GPL-2.0-only OR BSD-2-Clause
%YAML 1.2
---
$id: http://devicetree.org/schemas/interrupt-controller/kalray,coolidge-apic-gic.yaml#
$schema: http://devicetree.org/meta-schemas/core.yaml#

title: Kalray kv3-1 APIC-GIC

maintainers:
  - Jonathan Borne <jborne@kalrayinc.com>
  - Julian Vetter <jvetter@kalrayinc.com>
  - Yann Sionneau <ysionneau@kalrayinc.com>

description: |
  Each cluster in the Coolidge SoC includes an Advanced Programmable Interrupt
  Controller (APIC) which is split in two part:
    - a Generic Interrupt Controller (referred as APIC-GIC)
    - a Mailbox Controller           (referred as APIC-Mailbox)
  The APIC-GIC acts as an intermediary interrupt controller, muxing/routing
  incoming interrupts to output interrupts connected to kvx cores interrupts lines.
  The 139 possible input interrupt lines are organized as follow:
     - 128 from the mailbox controller (one it per mailboxes)
     - 1   from the NoC router
     - 5   from IOMMUs
     - 1   from L2 cache DMA job FIFO
     - 1   from cluster watchdog
     - 2   for SECC, DECC
     - 1   from Data NoC
  The 72 possible output interrupt lines:
     -  68 : 4 interrupts per cores (17 cores)
     -  1 for L2 cache controller
     -  3 extra that are for padding

properties:
  compatible:
    const: kalray,coolidge-apic-gic

  reg:
    maxItems: 1

  "#interrupt-cells":
    const: 1
    description: The IRQ number.

  interrupt-controller: true

  interrupts-extended:
    maxItems: 16
    description: |
     Specifies the interrupt line(s) in the interrupt-parent controller node;
     valid values depend on the type of parent interrupt controller

required:
  - compatible
  - reg
  - "#interrupt-cells"
  - interrupt-controller
  - interrupts-extended

additionalProperties: false

examples:
  - |
    apic_gic: interrupt-controller@a20000 {
        compatible = "kalray,coolidge-apic-gic";
        reg = <0 0xa20000 0 0x12000>;
        #interrupt-cells = <1>;
        interrupt-controller;
        interrupts-extended = <&core_intc0 0x4>,
                              <&core_intc1 0x4>,
                              <&core_intc2 0x4>,
                              <&core_intc3 0x4>,
                              <&core_intc4 0x4>,
                              <&core_intc5 0x4>,
                              <&core_intc6 0x4>,
                              <&core_intc7 0x4>,
                              <&core_intc8 0x4>,
                              <&core_intc9 0x4>,
                              <&core_intc10 0x4>,
                              <&core_intc11 0x4>,
                              <&core_intc12 0x4>,
                              <&core_intc13 0x4>,
                              <&core_intc14 0x4>,
                              <&core_intc15 0x4>;
    };

...
```

## Documentation/devicetree/bindings/interrupt-controller/kalray,coolidge-apic-mailbox.yaml
```yaml
# SPDX-License-Identifier: GPL-2.0-only OR BSD-2-Clause
%YAML 1.2
---
$id: http://devicetree.org/schemas/interrupt-controller/kalray,coolidge-apic-mailbox.yaml#
$schema: http://devicetree.org/meta-schemas/core.yaml#

title: Kalray Coolidge APIC-Mailbox

maintainers:
  - Jonathan Borne <jborne@kalrayinc.com>
  - Julian Vetter <jvetter@kalrayinc.com>
  - Yann Sionneau <ysionneau@kalrayinc.com>

description: |
  Each cluster in the Coolidge SoC includes an Advanced Programmable Interrupt
  Controller (APIC) which is split in two part:
    - a Generic Interrupt Controller (referred as APIC-GIC)
    - a Mailbox Controller           (referred as APIC-Mailbox)
  The APIC-Mailbox contains 128 mailboxes of 8 bytes (size of a word),
  this hardware block is basically a 1 KB of smart memory space.
  Each mailbox can be independently configured with a trigger condition
  and an input mode function.

  Input mode are:
   - write
   - bitwise OR
   - add

  Interrupts are generated on a write when the mailbox content value
  match the configured trigger condition.
  Available conditions are:
   - doorbell: always raise interruption on write
   - match: when the mailbox's value equal the configured trigger value
   - barrier: same as match but the mailbox's value is cleared on trigger
   - threshold: when the mailbox's value is greater than, or equal to, the
     configured trigger value

  Since this hardware block generates IRQs based on writes to some memory
  locations, it is both an interrupt controller and an MSI controller.

properties:
  compatible:
    const: kalray,coolidge-apic-mailbox

  reg:
    maxItems: 1

  "#interrupt-cells":
    const: 0
    description:
      The IRQ number.

  "#address-cells":
    const: 0

  interrupt-controller: true

  interrupts:
    maxItems: 128
    minItems: 1
    description: |
     Specifies the interrupt line(s) in the interrupt-parent controller node;
     valid values depend on the type of parent interrupt controller

  msi-controller: true

additionalProperties: false

required:
  - compatible
  - reg
  - "#interrupt-cells"
  - "#address-cells"
  - interrupt-controller
  - interrupts
  - msi-controller

examples:
  - |
    apic_mailbox: interrupt-controller@a00000 {
        compatible = "kalray,coolidge-apic-mailbox";
        reg = <0 0xa00000 0 0x0f200>;
        #interrupt-cells = <0>;
        interrupt-controller;
        interrupt-parent = <&apic_gic>;
        interrupts = <0>, <1>, <2>, <3>, <4>, <5>, <6>, <7>, <8>, <9>;
        msi-controller;
    };

...
```

## Documentation/devicetree/bindings/interrupt-controller/kalray,coolidge-ipi-ctrl.yaml
```yaml
# SPDX-License-Identifier: GPL-2.0-only OR BSD-2-Clause
%YAML 1.2
---
$id: http://devicetree.org/schemas/interrupt-controller/kalray,coolidge-ipi-ctrl.yaml#
$schema: http://devicetree.org/meta-schemas/core.yaml#

title: Kalray Coolidge SoC Inter-Processor Interrupt Controller (IPI)

maintainers:
  - Jonathan Borne <jborne@kalrayinc.com>
  - Julian Vetter <jvetter@kalrayinc.com>
  - Yann Sionneau <ysionneau@kalrayinc.com>

description: |
  The Inter-Processor Interrupt Controller (IPI) provides a fast synchronization
  mechanism to the software. It exposes eight independent set of registers that
  can be use to notify each processor in the cluster.
  A set of registers contains two 32-bit registers:
    - 17-bit interrupt control, one bit per core, raise an interrupt on write
    - 17-bit mask, one per core, to enable interrupts

  Bit at offsets 0 to 15 selects cores in the cluster, respectively PE0 to PE15,
  while bit at offset 16 is for the cluster Resource Manager (RM) core.

  The eight output interrupts are connected to each processor core interrupt
  controller (intc).

properties:
  compatible:
    const: kalray,coolidge-ipi-ctrl

  reg:
    maxItems: 1

  interrupts-extended:
    maxItems: 16
    description: |
      Specifies the interrupt line the IPI controller will raise on the core INTC.

  interrupt-controller: true

  '#interrupt-cells':
    const: 0

additionalProperties: false

required:
  - compatible
  - reg
  - interrupts-extended
  - interrupt-controller
  - '#interrupt-cells'

examples:
  - |
    ipi: inter-processor-interrupt@ad0000 {
        compatible = "kalray,coolidge-ipi-ctrl";
        reg = <0x00 0xad0000 0x00 0x1000>;
        #interrupt-cells = <0>;
        interrupt-controller;
        interrupts-extended = <&core_intc0 24>,
                              <&core_intc1 24>,
                              <&core_intc2 24>,
                              <&core_intc3 24>,
                              <&core_intc4 24>,
                              <&core_intc5 24>,
                              <&core_intc6 24>,
                              <&core_intc7 24>,
                              <&core_intc8 24>,
                              <&core_intc9 24>,
                              <&core_intc10 24>,
                              <&core_intc11 24>,
                              <&core_intc12 24>,
                              <&core_intc13 24>,
                              <&core_intc14 24>,
                              <&core_intc15 24>;
    };

...
```

## Documentation/devicetree/bindings/interrupt-controller/kalray,coolidge-itgen.yaml
```yaml
# SPDX-License-Identifier: GPL-2.0-only OR BSD-2-Clause
%YAML 1.2
---
$id: http://devicetree.org/schemas/interrupt-controller/kalray,coolidge-itgen.yaml#
$schema: http://devicetree.org/meta-schemas/core.yaml#

title: Kalray Coolidge SoC Interrupt Generator (ITGEN)

maintainers:
  - Jonathan Borne <jborne@kalrayinc.com>
  - Julian Vetter <jvetter@kalrayinc.com>
  - Yann Sionneau <ysionneau@kalrayinc.com>

description: |
  The Interrupt Generator (ITGEN) is an interrupt controller block.
  It's purpose is to convert IRQ lines coming from SoC peripherals into writes
  on the AXI bus. The ITGEN intended purpose is to write into the APIC mailboxes.

properties:
  compatible:
    const: kalray,coolidge-itgen

  reg:
    maxItems: 1

  "#interrupt-cells":
    const: 2
    description: |
      - 1st cell is for the IRQ number
      - 2nd cell is for the trigger type as defined dt-bindings/interrupt-controller/irq.h

  interrupt-controller: true

  msi-parent: true

additionalProperties: false

required:
  - compatible
  - reg
  - "#interrupt-cells"
  - interrupt-controller
  - msi-parent

examples:
  - |
    itgen: interrupt-controller@27000000 {
        compatible = "kalray,coolidge-itgen";
        reg = <0 0x27000000 0 0x1104>;
        #interrupt-cells = <2>;
        interrupt-controller;
        msi-parent = <&apic_mailbox>;
    };

...
```

## Documentation/devicetree/bindings/interrupt-controller/kalray,k1c-core-intc.txt
```
* K1C Core Interrupt controller

Required properties:

- compatible: must to be "kalray,k1c-core-intc".
- interrupt-controller
- #interrupt-cells: has to be <1>: an interrupt index
- regs: Base address of interrupt controller registers.

Optional properties:

- kalray,intc-nr-irqs: Number of irqs handled by the controller.
  if not given, will default to 32.

Example:

	core_intc: core_intc@0 {
		compatible = "kalray,k1c-core-intc";
		#interrupt-cells = <1>;
		interrupt-controller;
		interrupt-parent = <&core_intc>;
	};
```
