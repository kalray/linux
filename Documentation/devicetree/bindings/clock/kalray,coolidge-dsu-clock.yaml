## Documentation/devicetree/bindings/interrupt-controller/kalray,kv3-1-apic-gic.yaml
```yaml
# SPDX-License-Identifier: (GPL-2.0-only OR BSD-2-Clause)
%YAML 1.2
---
$id: http://devicetree.org/schemas/interrupt-controller/kalray,coolidge-apic-gic.yaml#
$schema: http://devicetree.org/meta-schemas/core.yaml#

title: Kalray Coolidge SoC APIC-GIC

maintainers:
  - Yann Sionneau <ysionneau@kalray.eu>
  - Jules Maselbas <jmaselbas@kalray.eu>
  - Julian Vetter <jvetter@kalray.eu>

description: |
  Each cluster in the Coolidge SoC includes an Advanced Programmable Interrupt
  Controller (APIC) which is split in two part:
    - a Generic Interrupt Controller (referred as APIC-GIC)
    - a Mailbox Controller           (referred as APIC-Mailbox)
  The APIC-GIC acts as an intermediary interrupt controller, muxing/routing
  incoming interrupts to output interrupts connected to cores interrupts lines.
  The 139 possible input interrupt lines are organized as follow:
     - 128 from the mailbox controller (one it per mailboxes)
     - 1   from the NoC router
     - 5   from IOMMUs
     - 1   from L2 cache DMA job FIFO
     - 1   from cluster watchdog
     - 2   for SECC, DECC
     - 1   from Data NoC
  The 72 possible output interrupt lines:
     -  68 : 4 interrupts per core (17 cores)
     -  1 for L2 cache controller
     -  3 extra, unused, for padding

allOf:
  - $ref: /schemas/interrupt-controller.yaml#

properties:
  compatible:
    const: kalray,coolidge-v1-apic-gic

  reg:
    maxItems: 1

  "#interrupt-cells":
    const: 1
    description:
      The IRQ number.

  interrupt-controller: true

  interrupts:
    maxItems: 4
    description: |
     Specifies the interrupt line(s) in the interrupt-parent controller node;
     valid values depend on the type of parent interrupt controller

required:
  - compatible
  - reg
  - "#interrupt-cells"
  - interrupt-controller
  - interrupts

additionalProperties: false

examples:
  - |
    apic_gic: interrupt-controller@a20000 {
        compatible = "kalray,coolidge-v1-apic-gic";
        reg = <0xa20000 0x12000>;
        #interrupt-cells = <1>;
        interrupt-controller;
        interrupt-parent = <&intc>;
        interrupts = <4>, <5>, <6>, <7>;
    };

...
```

## Documentation/devicetree/bindings/interrupt-controller/kalray,kv3-1-apic-mailbox.yaml
```yaml
# SPDX-License-Identifier: (GPL-2.0-only OR BSD-2-Clause)
%YAML 1.2
---
$id: http://devicetree.org/schemas/interrupt-controller/kalray,kv3-1-apic-mailbox.yaml#
$schema: http://devicetree.org/meta-schemas/core.yaml#

title: Kalray kv3-1 APIC-Mailbox

maintainers:
  - Yann Sionneau <ysionneau@kalray.eu>
  - Jules Maselbas <jmaselbas@kalray.eu>
  - Julian Vetter <jvetter@kalray.eu>

description: |
  Each cluster in the Coolidge SoC includes an Advanced Programmable Interrupt
  Controller (APIC) which is split in two part:
    - a Generic Interrupt Controller (referred as APIC-GIC)
    - a Mailbox Controller           (referred as APIC-Mailbox)
  The APIC-Mailbox contains 128 mailboxes of 8 bytes (size of a word),
  this hardware block is basically a 1 KB of smart memory space.
  Each mailbox can be independently configured with a trigger condition
  and an input mode function.

  Input mode are:
   - write
   - bitwise OR
   - add

  Interrupts are generated on a write when the mailbox content value
  match the configured trigger condition.
  Available conditions are:
   - doorbell: always raise interruption on write
   - match: when the mailbox's value equal the configured trigger value
   - barrier: same as match but the mailbox's value is cleared on trigger
   - threshold: when the mailbox's value is greater than, or equal to, the
     configured trigger value

  Since this hardware block generates IRQs based on writes to some memory
  locations, it is both an interrupt controller and an MSI controller.

allOf:
  - $ref: /schemas/interrupt-controller.yaml#

properties:
  compatible:
    const: kalray,kv3-1-apic-mailbox

  reg:
    maxItems: 1

  "#interrupt-cells":
    const: 0

  interrupt-controller: true

  interrupts:
    minItems: 1
    maxItems: 128
    description: |
     Specifies the interrupt line(s) in the interrupt-parent controller node;
     valid values depend on the type of parent interrupt controller

  msi-controller: true

required:
  - compatible
  - reg
  - "#interrupt-cells"
  - interrupts
  - interrupt-controller
  - msi-controller

additionalProperties: false

examples:
  - |
    apic_mailbox: interrupt-controller@a00000 {
        compatible = "kalray,kv3-1-apic-mailbox";
        reg = <0xa00000 0x0f200>;
        #interrupt-cells = <0>;
        interrupt-controller;
        interrupt-parent = <&apic_gic>;
        interrupts = <0 1 2 3 4 5 6 7>;
        msi-controller;
    };

...
```

## Documentation/devicetree/bindings/interrupt-controller/kalray,kv3-1-core-intc.yaml
```yaml
# SPDX-License-Identifier: (GPL-2.0-only OR BSD-2-Clause)
%YAML 1.2
---
$id: http://devicetree.org/schemas/interrupt-controller/kalray,kv3-1-intc.yaml#
$schema: http://devicetree.org/meta-schemas/core.yaml#

title: Kalray kv3-1 core Interrupt Controller

maintainers:
  - Yann Sionneau <ysionneau@kalray.eu>
  - Jules Maselbas <jmaselbas@kalray.eu>
  - Julian Vetter <jvetter@kalray.eu>

description: |
  The Kalray Core Interrupt Controller is tightly integrated in each kv3 core
  present in the Coolidge SoC.

  It provides the following features:
  - 32 independent interrupt sources
  - 2-bit configurable priority level
  - 2-bit configurable ownership level

allOf:
  - $ref: /schemas/interrupt-controller.yaml#

properties:
  compatible:
    items:
      - const: kalray,kv3-1-intc

  "#interrupt-cells":
    const: 1
    description:
      The IRQ number.

required:
  - compatible
  - "#interrupt-cells"
  - interrupt-controller

additionalProperties: false

examples:
  - |
    intc: interrupt-controller {
        compatible = "kalray,kv3-1-intc";
        #interrupt-cells = <1>;
        interrupt-controller;
    };

...
```

## Documentation/devicetree/bindings/interrupt-controller/kalray,kv3-1-intc.yaml
```yaml
# SPDX-License-Identifier: GPL-2.0-only OR BSD-2-Clause
%YAML 1.2
---
$id: http://devicetree.org/schemas/interrupt-controller/kalray,kv3-1-intc.yaml#
$schema: http://devicetree.org/meta-schemas/core.yaml#

title: Kalray kv3-1 Core Interrupt Controller

maintainers:
  - Jonathan Borne <jborne@kalrayinc.com>
  - Julian Vetter <jvetter@kalrayinc.com>
  - Yann Sionneau <ysionneau@kalrayinc.com>

description: |
  The Kalray Core Interrupt Controller is tightly integrated in each kv3 core
  present in the Coolidge SoC.

  It provides the following features:
  - 32 independent interrupt sources
  - 2-bit configurable priority level
  - 2-bit configurable ownership level

properties:
  compatible:
    const: kalray,kv3-1-intc

  "#interrupt-cells":
    const: 1
    description:
      The IRQ number.

  "#address-cells":
    const: 0

  interrupt-controller: true

additionalProperties: false

required:
  - compatible
  - "#interrupt-cells"
  - "#address-cells"
  - interrupt-controller

examples:
  - |
    intc: interrupt-controller {
        compatible = "kalray,kv3-1-intc";
        #interrupt-cells = <1>;
        #address-cells = <0>;
        interrupt-controller;
    };

...
```

## Documentation/devicetree/bindings/iommu/kalray,k1c-iommu.txt
```
* Kalray IOMMU Architecture Implementation

Required properties:

- compatible        : must be the following string:
			"kalray,k1c-iommu"
- reg               : Base address and size of the IOMMU.
- interrupts        : List describing the wired interrupt sources.
- interrupt-names   : To be described
- #iommu-cells      : Should be <0>
		      See the generic IOMMU binding described in
                        devicetree/bindings/pci/pci-iommu.txt

Example:
    iommu_noc: iommu_noc@0 {
        compatible = "kalray,k1c-iommu";
        reg = <0x0 0x00AC2000 0x0 0x00000240>,
              <0x0 0x00AC3000 0x0 0x00000240>;
        reg-names = "rx", "tx";
        interrupts = <134>, <135>, <136>,
                     <137>, <138>, <139>;
        interrupt-names = "rx_nomapping", "rx_protection", "rx_parity",
                          "tx_nomapping", "tx_protection", "tx_parity";
        interrupt-parent = <&apic_gic>;
        #iommu-cells = <0>;
    };

Example with devices that use this iommu:

    dma_noc: dma_noc@0x800000 {
            compatible = "kalray,k1c-dma-noc";
            #dma-cells = <1>;
            reg = <0 0x1800000 0 0x100000>;
            dma-channels = <64>;
            dma-requests = <127>;
            msi-parent = <&apic_mailbox>;
            iommus = <&iommu_noc>;
    };

    test_dmaengine@0 {
            compatible = "kalray,k1c-dma-noc-test";
            dmas = <&dma_noc 1>;
            dma-names = "k1c-dma-noc";
            cluster-rx = <2>;  // rx_tag to cluster
            iommus = <&iommu_noc>;
    };
```

## Documentation/devicetree/bindings/kalray/cpus.yaml
```yaml
# SPDX-License-Identifier: GPL-2.0-only OR BSD-2-Clause
%YAML 1.2
---
$id: http://devicetree.org/schemas/kalray/cpus.yaml#
$schema: http://devicetree.org/meta-schemas/core.yaml#

title: Kalray CPUs

maintainers:
  - Jonathan Borne <jborne@kalrayinc.com>
  - Julian Vetter <jvetter@kalrayinc.com>
  - Yann Sionneau <ysionneau@kalrayinc.com>

allOf:
  - $ref: /schemas/cpu.yaml#

properties:
  reg:
    maxItems: 1
    description: |
      Contains the CPU number.

  compatible:
    oneOf:
      - items:
          - const: kalray,kv3-1-pe
          - const: kalray,kv3-pe

  clocks:
    maxItems: 1

  enable-method:
    const: "kalray,coolidge-pwr-ctrl"

  interrupt-controller:
    type: object
    additionalProperties: false
    description: Describes the CPU's local interrupt controller

    properties:
      '#interrupt-cells':
        const: 1

      compatible:
        const: kalray,kv3-1-intc

      interrupt-controller: true

      '#address-cells':
        const: 0

    required:
      - compatible
      - '#interrupt-cells'
      - '#address-cells'
      - interrupt-controller

if:
  properties:
    reg:
      const: 0
then:
  required:
    - clocks

required:
  - reg
  - compatible
  - interrupt-controller

unevaluatedProperties: false

examples:
  - |

    cpus {
        #size-cells = <0>;
        #address-cells = <1>;

       cpu@0 {
         compatible = "kalray,kv3-1-pe";
         device_type = "cpu";
         reg = <0>;
         clocks = <&core_clk>;
         cpu_intc0: interrupt-controller {
           compatible = "kalray,kv3-1-intc";
           #interrupt-cells = <1>;
           #address-cells = <0>;
           interrupt-controller;
         };
       };


       cpu@1 {
         compatible = "kalray,kv3-1-pe";
         device_type = "cpu";
         reg = <1>;
         cpu_intc1: interrupt-controller {
           compatible = "kalray,kv3-1-intc";
           #interrupt-cells = <1>;
           #address-cells = <0>;
           interrupt-controller;
         };
       };
    };
```

## Documentation/devicetree/bindings/kalray/kalray,kv3-1-ipi-ctrl.yaml
```yaml
# SPDX-License-Identifier: (GPL-2.0-only OR BSD-2-Clause)
%YAML 1.2
---
$id: http://devicetree.org/schemas/kalray/kalray,kv3-1-ipi-ctrl.yaml#
$schema: http://devicetree.org/meta-schemas/core.yaml#

title: Kalray kv3-1 Inter-Processor Interrupt Controller (IPI)

maintainers:
  - Yann Sionneau <ysionneau@kalray.eu>
  - Jules Maselbas <jmaselbas@kalray.eu>
  - Julian Vetter <jvetter@kalray.eu>

description: |
  The Inter-Processor Interrupt Controller (IPI) provides a fast synchronization
  mechanism to the software. It exposes eight independent set of registers that
  can be use to notify each processor in the cluster.
  A set of registers contains two 32-bit registers:
    - 17-bit interrupt control, one bit per core, raise an interrupt on write
    - 17-bit mask, one per core, to enable interrupts

  Bit at offsets 0 to 15 selects cores in the cluster, respectively PE0 to PE15,
  while bit at offset 16 is for the cluster Resource Manager (RM) core.

  The eight output interrupts are connected to each processor core interrupt
  controller (intc).

properties:
  compatible:
    const: kalray,kv3-1-ipi-ctrl

  reg:
    maxItems: 1

required:
  - compatible
  - reg
  - interrupt-parent
  - interrupts

additionalProperties: false

examples:
  - |
    ipi: inter-processor-interrupt@ad0000 {
        compatible = "kalray,kv3-1-ipi-ctrl";
        reg = <0xad0000 0x1000>;
        interrupt-parent = <&intc>;
        interrupts = <24>;
    };

...
```

## Documentation/devicetree/bindings/kalray/kalray,kv3-1-pwr-ctrl.yaml
```yaml
# SPDX-License-Identifier: (GPL-2.0-only OR BSD-2-Clause)
%YAML 1.2
---
$id: http://devicetree.org/schemas/kalray/kalray,kv3-1-pwr-ctrl.yaml#
$schema: http://devicetree.org/meta-schemas/core.yaml#

title: Kalray cluster Power Controller (pwr-ctrl)

maintainers:
  - Yann Sionneau <ysionneau@kalray.eu>
  - Jules Maselbas <jmaselbas@kalray.eu>
  - Julian Vetter <jvetter@kalray.eu>

description: |
  The Power Controller (pwr-ctrl) control cores reset and wake-up procedure.

properties:
  compatible:
    const: kalray,kv3-1-pwr-ctrl

  reg:
    maxItems: 1

required:
  - compatible
  - reg

additionalProperties: false

examples:
  - |
    pwr_ctrl: power-controller@a40000 {
        compatible = "kalray,kv3-1-pwr-ctrl";
        reg = <0xa40000 0x4158>;
    };

...
```

## Documentation/devicetree/bindings/kalray/kalray.yaml
```yaml
# SPDX-License-Identifier: GPL-2.0-only OR BSD-2-Clause
%YAML 1.2
---
$id: http://devicetree.org/schemas/kalray/kalray.yaml#
$schema: http://devicetree.org/meta-schemas/core.yaml#

title: Kalray SoC-based boards

maintainers:
  - Jonathan Borne <jborne@kalrayinc.com>
  - Julian Vetter <jvetter@kalrayinc.com>
  - Yann Sionneau <ysionneau@kalrayinc.com>

properties:
  $nodename:
    const: '/'
  compatible:
    oneOf:
      - description: Kalray Coolidge SoC on qemu
        const: kalray,coolidge-qemu

additionalProperties: true
```

## Documentation/devicetree/bindings/net/kalray,k1c-net.txt
```
* Phy definition

- reg: phy id as used in driver (see bindings/net/phy.txt)
- phy-mode: see bindings/net/ethernet.txt

* Kalray net controller

Required properties:
- compatible: Should be "kalray,k1c-eth"
- reg: {phy, mac, eth} registers and length
- reg-names: {phy, mac, eth} names

Optional properties:
- cell-index: ethernet hw index, used for packet routing

* Kalray netdev

Required properties:
- compatible: Should be "kalray,k1c-net";
- dmas: dma-noc channels
- dma-names: as defined in bindings/dma/dma.txt
- phy-handle: related to a phy definition
- sfp: sfp definition


Example:

	sfp_eth0: sfp-eth0 {
		  compatible = "sff,sfp";
		  i2c-bus = <&sfpp0_i2c>;
	};

	mdio-bus {
		#address-cells = <1>;
		#size-cells = <0>;
		phy0: ethernet-phy@0 {
			reg = <0>;
			phy-mode = "sgmii";
			device_type = "ethernet-phy";
			fixed-link {
				speed = <1000>;
				full-duplex;
			};
		};
	};

	eth0: ethernet@10050000 {
		compatible = "kalray,k1c-eth";
		reg = <0x0 0x10040000 0x0 0xB4>,
		      <0x0 0x10050000 0x0 0x8ED0>,
		      <0x0 0x10090000 0x0 0x16400>;
		reg-names = "phy", "mac", "eth";
		cell-index = <0>;

		port0: ethernet-port@0 {
			compatible = "kalray,k1c-net";
			dmas = <&dma_noc 1>, <&dma_noc 1>;
			dma-names = "rx", "tx";
			phy-handle = <&phy0>;
			sfp = <&sfp_eth0>;
		};
	};
```
